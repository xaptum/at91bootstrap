## contrib/board/xaptum/xaprc001/xaprc001mmc_uboot_dev_defconfig
```kconfig
CONFIG_XAPRC001=y
CONFIG_RAM_256MB=y
CONFIG_DDR3=y
CONFIG_SDCARD=y
CONFIG_SDHC0=y
CONFIG_DEBUG=y
CONFIG_SCLK=y
CONFIG_SCLK_BYPASS=y
# CONFIG_ENTER_NWD is not set
```

## contrib/board/xaptum/xaprc001/xaprc001ram_uboot_dev_defconfig
```kconfig
CONFIG_XAPRC001_PROV=y
CONFIG_RAM_256MB=y
CONFIG_DDR3=y
CONFIG_SDHC_VOLTAGE_1_8=y
CONFIG_DEBUG=y
CONFIG_SCLK_BYPASS=y
CONFIG_NOFLASH=y
CONFIG_CONFIG_JUMP_ADDR=0x26f00000
# CONFIG_ENTER_NWD is not set
```
